## boards/shields/theoth_board/Kconfig.shield
```kconfig
# Copyright (c) 2025 Nguyen Nhat Minh
# SPDX-License-Identifier: MIT

config SHIELD_THEOTH_BOARD
    def_bool $(shields_list_contains,theoth_board)
```
